// DOOOPE_left.overlay

#include "DOOOPE.dtsi" // Notice that the main dtsi files are included in the overlay.

&kscan0 {
    col-gpios
        = <&xiao_d 0 GPIO_ACTIVE_HIGH> // col0 in the schematic
        , <&xiao_d 1 GPIO_ACTIVE_HIGH> // col1 in the schematic
        , <&xiao_d 10 GPIO_ACTIVE_HIGH> // col2 in the schematic
        , <&xiao_d 9 GPIO_ACTIVE_HIGH> // col3 in the schematic
        , <&xiao_d 8 GPIO_ACTIVE_HIGH> // col4 in the schematic
        , <&xiao_d 7 GPIO_ACTIVE_HIGH> // col5 in the schematic
        ;
    
     row-gpios
        = <&xiao_d 2 (GPIO_ACTIVE_HIGH | GPIO_PULL_DOWN)> // row3 in the schematic
        , <&xiao_d 3 (GPIO_ACTIVE_HIGH | GPIO_PULL_DOWN)> // row2 in the schematic
        , <&xiao_d 4 (GPIO_ACTIVE_HIGH | GPIO_PULL_DOWN)> // row1 in the schematic
        , <&xiao_d 5 (GPIO_ACTIVE_HIGH | GPIO_PULL_DOWN)> // row0 in the schematic
        ;
};