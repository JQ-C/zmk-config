## config/boards/shields/DOOOPE/Kconfig.defconfig
```kconfig
if SHIELD_DOOOPE_LEFT

config ZMK_KEYBOARD_NAME
    default "DOOOPE"

config ZMK_SPLIT_ROLE_CENTRAL
    default y

endif

if SHIELD_DOOOPE_LEFT || SHIELD_DOOOPE_RIGHT

config ZMK_SPLIT
    default y

endif
```

## config/boards/shields/DOOOPE/Kconfig.shield
```kconfig
config SHIELD_DOOOPE_LEFT
    def_bool $(shields_list_contains,DOOOPE_left)

config SHIELD_DOOOPE_RIGHT
    def_bool $(shields_list_contains,DOOOPE_right)

# Turn on logging, and set ZMK logging to debug output
CONFIG_ZMK_USB_LOGGING=y
```
